// SPDX-License-Identifier: (GPL-2.0+ OR MIT)
/*
 * Copyright (c) 2022 Mixtile Limited
 *
 */

/dts-v1/;

#include "rk3588.dtsi"
#include "rk3588-u-boot.dtsi"
#include <dt-bindings/input/input.h>

/ {
	model = "Mixtile Core 3588E";
	compatible = "mixtile,core3588e", "rockchip,rk3588";
};
